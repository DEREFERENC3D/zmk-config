## boards/shields/knob_lmao/Kconfig.defconfig
```kconfig
if SHIELD_KNOB_LMAO

config ZMK_KEYBOARD_NAME
    default "knob_lmao"

endif # SHIELD_KNOB_LMAO
```

## config/west.yml
```yaml
manifest:
  defaults:
    revision: encoder
  remotes:
    - name: zmkfirmware
      url-base: https://github.com/DEREFERENC3D
    - name: infused-kim
      url-base: https://github.com/infused-kim
  projects:
    - name: zmk
      remote: zmkfirmware
      import: app/west.yml
    - name: kb_zmk_ps2_mouse_trackpoint_driver
      remote: infused-kim
      revision: main
  self:
    path: config
```
