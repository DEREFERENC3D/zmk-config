/ {
	knob_button: kscan_direct {
        compatible = "zmk,kscan-gpio-direct";
        wakeup-source;

        input-gpios = <&pro_micro 21 (GPIO_ACTIVE_LOW | GPIO_PULL_UP)>;

        // defaults, possibly optional
        debounce-press-ms = <5>;
        debounce-release-ms = <5>;
        debounce-scan-period-ms = <1>;
        poll-period-ms = <10>;
    };
};
